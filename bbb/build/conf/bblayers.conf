## bbb/build/conf/bblayers.conf
```bitbake
# POKY_BBLAYERS_CONF_VERSION is increased each time build/conf/bblayers.conf
# changes incompatibly
POKY_BBLAYERS_CONF_VERSION = "2"

BBPATH = "${TOPDIR}"
BBFILES ?= ""

BBLAYERS ?= " \
  ${HOME}/trebletrouble/poky-krogoth/meta \
  ${HOME}/trebletrouble/poky-krogoth/meta-poky \
  ${HOME}/trebletrouble/poky-krogoth/meta-openembedded/meta-networking \
  ${HOME}/trebletrouble/poky-krogoth/meta-openembedded/meta-oe \
  ${HOME}/trebletrouble/poky-krogoth/meta-openembedded/meta-python \
  ${HOME}/trebletrouble/poky-krogoth/meta-qt5 \
  ${HOME}/trebletrouble/bbb/meta-bbb \
  "
```
